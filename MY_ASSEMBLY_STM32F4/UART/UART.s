; Author: NGUYEN VAN THANH 
; GPIOD PIN2 TX  ...... GPIOD PIN3 RX
GPIOA_BASE 			EQU 0x40020000
RCC_BASE			EQU 0x40023800
USART2				EQU 0x40004400

		AREA |.text|, CODE , READONLY, ALIGN=2
		THUMB
		EXPORT UART_Init
		EXPORT RECEIV_DATA

			

			;BL READ_UART
UART_Init
; GPIOA2-> TX      GPIOA3 ->RX
		LDR R0,=RCC_BASE + 0x30 ; AHB1ERN
		LDR R1,[R0]
		ORR R1,R1,#1<<0 ; RCC GPIOA EN
		STR R1,[R0]
		
		LDR R0,=RCC_BASE +0x40 ; APB1ENR 
		LDR R1,[R0]
		ORR R1,R1,#1<<17 ; RCC USART2 EN
		STR R1,[R0]
		
		LDR R0,=GPIOA_BASE + 0x00 ; MODER
		LDR R1,[R0]
		BIC R1,R1,#15<<4 ; CLEAR BIT
		ORR R1,R1,#2<<4	; AF MODE  0x1010 <<4
		ORR R1,R1,#2<<6
		STR R1,[R0]
		
		LDR R0,=GPIOA_BASE + 0x20 ; AFRL 
		STR R1,[R0]
		BIC R1,R1,#15<<8 ; CLEAR BIT
		ORR R1,R1,#7<<8 ; MAPPING AF07 , GPIOA2 TX
		STR R1,[R0]
		
		LDR R0,=GPIOA_BASE + 0x20 ; AFRL 
		STR R1,[R0]
		BIC R1,R1,#15<<12 ; CLEAR BIT
		ORR R1,R1,#7<<12 ; MAPPING AF07 , GPIOA3 RX
		STR R1,[R0]
		
		LDR R0,=USART2 + 0x08 ; BRR 
	MOVW 	R1,#0x683 ; BRR=16MHZ /9600 -> BRR=1667 H -> 0x683
			; BRR=16MHZ/115200 -> BRR=139 -> 0x88
		STR R1,[R0]
		
		LDR R0,=USART2 + 0x0C ; CR1
		LDR R1,[R0]
		ORR R1,R1,#1<<2 ; RX ENABLE
		STR R1,[R0]
		
		LDR R0,=USART2 + 0x0C ; CR1
		LDR R1,[R0]
		ORR R1,R1,#1<<3 ; TX ENABLE
		STR R1,[R0]
	
		LDR R0,=USART2 + 0x0C ; CR1
		LDR R1,[R0]
		ORR R1,R1,#1<<13 ; USART EN
		STR R1,[R0]
RECEIV_DATA 
		LDR R1,=USART2 + 0x00 ; SR
WAITTX	LDR R2,[R1]
		AND R2,#1<<5 ; TXE 
		CMP R2,#0
		BEQ	WAITTX
		
		LDR R3,=USART2 + 0x04 ; DR
		LDR R0,[R3]
		BX LR
		ALIGN
		END

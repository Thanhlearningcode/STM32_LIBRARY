RCC_BASE 	EQU 0x40023800
GPIOA_BASE		EQU 0x40020000
TIM1_BASE	EQU 0x40010000
TIM1_CR1	EQU TIM1_BASE + 0x00
TIM1_EGR	EQU TIM1_BASE + 0x14
TIM1_CNT	EQU TIM1_BASE + 0x24
TIM1_SR		EQU TIM1_BASE + 0x10
TIM1_ARR	EQU TIM1_BASE + 0x2C
TIM1_PSC	EQU TIM1_BASE + 0x28
RCC_AHB1ENR	EQU RCC_BASE + 0x30
RCC_APB2ENR EQU RCC_BASE + 0x44
GPIOA_MODER	EQU GPIOA_BASE + 0x00
GPIOA_OTYPER	EQU GPIOA_BASE + 0x04
GPIOA_PUPDR	EQU	GPIOA_BASE + 0x0C
GPIOA_ODR	EQU	GPIOA_BASE + 0x14

	AREA |.text|, CODE, READONLY, ALIGN=2
	THUMB
	ENTRY
	EXPORT __main
__main
	BL 		RCC_CLOCK
	BL		GPIO_INIT
	BL		TIM_INIT
	BL		LED_BLYNK
RCC_CLOCK	
	LDR R0,=RCC_AHB1ENR
	LDR R1,[R0]
	ORR R1,R1,#1<<0; RCC_GPIOA ENABLE
	STR R1,[R0]
	
	LDR R0,=RCC_APB2ENR 
	LDR R1,[R0]
	ORR	R1,R1,#1<<0 ; RCC_TIM1 ENABLE
	STR R1,[R0]
	BX 	LR
GPIO_INIT	
;MODER OUTPUT
	LDR R0, =GPIOA_MODER
	LDR	R1, [R0]
	BIC R1, R1, #1<<2
	ORR R1, R1, #1<<2 ; OUTPUT
	STR R1, [R0]
;OTYPER PUSH-PULL
	LDR R0, =GPIOA_OTYPER
	LDR R1, [R0]
	BIC	R1, R1, #1<<1
	STR R1, [R0]
	BX LR

TIM_INIT	
	LDR R0, =TIM1_CNT
	MOV R1, #0
	STR	R1, [R0] ; TIM1->CNT=0;
	
	LDR R0, =TIM1_PSC	
	MOVW R1, #1599 ; 16000-1 TIM1->PSC=15999;
	STR R1, [R0]
	
	LDR R0, =TIM1_ARR
	MOVW R1, #9999 ; TIM1->ARR=9999;
	STR R1, [R0]
	
	LDR R0, =TIM1_CR1
	LDR R1, [R0]
	BIC	R1, R1, #1<<7 ; CLEAR BIT 
	ORR	R1, R1, #1<<7 ; TIMx_ARR register is buffered
	STR R1, [R0]
	
	LDR R0, =TIM1_CR1
	LDR R1, [R0]
	BIC	R1, R1, #1<<4 
	STR R1, [R0]
	
	LDR R0, =TIM1_CR1
	LDR R1, [R0]
	BIC R1, R1, #2<<2
	STR R1, [R0] 
	
	LDR R0, =TIM1_EGR
	LDR R1, [R0]
	ORR	R1, R1, #1<<0 ; Bit 0 UG: Update generation
	STR R1, [R0]
	
	LDR R0, =TIM1_CR1
	LDR R1, [R0]
	ORR	R1, R1, #1<<0 ; CEN enable
	STR R1, [R0]


DELAY1S
	
	LDR R3,= TIM1_EGR
	LDR R1, =TIM1_SR
WAIT_UPDATE_FLAG
	LDR R2, [R1]
	AND R2,#0x01 
	CMP R2,#0x00
	BEQ WAIT_UPDATE_FLAG 

	
	LDR R3, [R1]
	BIC R3, R3, #0x01
	STR R3, [R1]
	

	BX LR

LED_BLYNK
	LDR R0, =GPIOA_ODR
	MOVW R1, #1<<1 ; SET PIN1 
	STR R1, [R0]
	BL DELAY1S
	
	LDR R0, =GPIOA_ODR
	LDR R1, [R0]
	BIC	R1, R1, #1<<1 ; RESET PIN1
	STR R1, [R0]
	BL DELAY1S
	BL LED_BLYNK
	ALIGN 
END
